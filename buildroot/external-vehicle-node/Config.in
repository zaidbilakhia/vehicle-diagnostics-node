## buildroot/external-vehicle-node/configs/vehicle_node_qemu_x86_64_defconfig
```kconfig
BR2_x86_64=y
BR2_TOOLCHAIN_BUILDROOT_WCHAR=y
BR2_TOOLCHAIN_BUILDROOT_CXX=y
BR2_INIT_SYSTEMD=y
BR2_TARGET_GENERIC_GETTY_PORT="ttyS0"
BR2_SYSTEM_DHCP="eth0"
BR2_LINUX_KERNEL=y
BR2_LINUX_KERNEL_USE_ARCH_DEFAULT_CONFIG=y
BR2_TARGET_ROOTFS_EXT2=y
BR2_TARGET_ROOTFS_EXT2_4=y
BR2_TARGET_ROOTFS_EXT2_SIZE="120M"
# BR2_TARGET_ROOTFS_TAR is not set
BR2_PACKAGE_IPROUTE2=y
BR2_PACKAGE_CAN_UTILS=y
BR2_PACKAGE_VEHICLE_NODE=y
```

## buildroot/external-vehicle-node/package/vehicle-node/Config.in
```kconfig
config BR2_PACKAGE_VEHICLE_NODE
	bool "vehicle-node"
	depends on BR2_INSTALL_LIBSTDCPP
	help
	  A compact C++17 automotive Embedded Linux vehicle diagnostics
	  node with a systemd service, SocketCAN/vCAN availability checks,
	  JSON status output, and runtime logging.
```

## yocto/meta-vehicle-node/conf/layer.conf
```bitbake
BBPATH .= ":${LAYERDIR}"

BBFILES += "${LAYERDIR}/recipes-*/*/*.bb \
            ${LAYERDIR}/recipes-*/*/*.bbappend"

BBFILE_COLLECTIONS += "vehicle-node"
BBFILE_PATTERN_vehicle-node = "^${LAYERDIR}/"
BBFILE_PRIORITY_vehicle-node = "6"

LAYERSERIES_COMPAT_vehicle-node = "kirkstone langdale mickledore nanbield scarthgap styhead walnascar"
```
